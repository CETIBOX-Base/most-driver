## aim-isostream/Kconfig
```kconfig
config AIM_ISOSTREAM
	tristate "V4L2 AIM (isostream interface)"

	---help---
	  Say Y here if you want to communicate via V4L2 devices using
	  the interface of isostream driver, which supports both video
	  input and output.

	  To compile this driver as a module, choose M here: the
	  module will be called aim_isostream.
```

## aim-mlb150/Kconfig
```kconfig
config AIM_CDEV_MLB150
	tristate "Character device AIM (mlb150 interface)"

	---help---
	  Say Y here if you want to communicate via character devices using
	  the interface of mlb150 driver.

	  To compile this driver as a module, choose M here: the
	  module will be called aim_cdev_mlb150.
```

## aim-syncsound/Kconfig
```kconfig
config AIM_SYNCSOUND
	tristate "ALSA AIM (syncsound)"
	depends on SND
	select SND_PCM
	---help---
	  Say Y here if you want to communicate via ALSA/sound devices using
	  syncsound compatible modes.

	  To compile this driver as a module, choose M here: the
	  module will be called aim_syncsound.
```
